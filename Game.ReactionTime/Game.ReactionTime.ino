#include <Adafruit_CircuitPlayground.h>
#include <Wire.h>
#include <SPI.h>
#include <AsyncDelay.h>

//Variables for the gameplay
int val;
int score = 0;
int scoreLight = 0;
int spinSpeed = 120;

//Variabes for the interrupts
const int ButtA = 4;
volatile bool FlagA = 0;
const int ButtB = 5;
volatile bool FlagB = 0;
volatile bool instStop = 0;

//Variables for noise functions
float midi[127];
int A_four = 440;
int nextLevel[3][2]{
  { 60, 80 },
  { 62, 80 },
  { 64, 160 },
};

AsyncDelay delay_1s;

void setup() {

//Sets up the CPX functions, Serial mointor, interrupts, sound, and async 
  CircuitPlayground.begin();
  Serial.begin(9600);
  attachInterrupt(ButtA, game, RISING);
  attachInterrupt(ButtB, control, RISING);
  generateMIDI();
  delay_1s.start(1000, AsyncDelay::MILLIS);

  while (!Serial);
  Serial.println("Starting Game");
}

void loop() {

  CircuitPlayground.speaker.set(250);

  //Lights will spin around each LED as long as Button A is not pressed and the spin speed is above 20 millis
  for (int i = 0; i < 10 && !FlagA && spinSpeed != 20; i++) {
    CircuitPlayground.setBrightness(5);
    CircuitPlayground.setPixelColor(i, 255, 65, 0);
    CircuitPlayground.setPixelColor(i - 1, 255, 65, 0);
    CircuitPlayground.setPixelColor(i + 1, 255, 65, 0);
    delay(spinSpeed); //The LED will stay lit up for the amount of time in millis equal to spinSpeed
    CircuitPlayground.setPixelColor(i, 0, 0, 0);
    CircuitPlayground.setPixelColor(i + 1, 0, 0, 0);
    CircuitPlayground.setPixelColor(i - 1, 0, 0, 0);
    delay(1);
    int val = i;  //creates the value that is lit up as a global variable
    //If Button A is pressed, it reads if you level up
    if (FlagA) {
      //If the LED 7 is lit when Button A is pressed, add 5 to score, run Plus functions, and decrease spinSpeed (This makes the lights faster)
      if (val == 7) {
        score += 5;
        scoreboard();
        for (int i = 0; i < sizeof(nextLevel) / sizeof(nextLevel[0]); i++) {
          CircuitPlayground.playTone(midi[nextLevel[i][0]], nextLevel[i][1]);
          lightPlus();
          delay(1);
        }
        speechPlus();
        spinSpeed -= 10;
      //If LED 7 is not lit when Button A is pressed, subtract one from score, run Minus functions  
      }
      if (val != 7) {
        score -= 1;
        scoreboard();
        CircuitPlayground.setPixelColor(val, 255, 0, 0);
        CircuitPlayground.setPixelColor(val - 1, 0, 0, 0);
        CircuitPlayground.setPixelColor(val + 1, 0, 0, 0);
        speechMinus();
        delay(1000);
        CircuitPlayground.setPixelColor(val, 0, 0, 0);
      }
      FlagA = 0;
    }
  }

  //If Button B is pressed, restart the game at the starting speed and score
  if (FlagB) {
    Serial.println("Game Restart");
    spinSpeed = 120;
    score = 0;
    FlagB = 0;
    instStop = 0;
  }



  //Async that checks if the player has won the game. If they have, play Complete functions
  if (delay_1s.isExpired()) {
    if (spinSpeed == 20 && !FlagB && !instStop) {
      scoreComplete();
      lightComplete();
      speechComplete();
    }
    delay_1s.repeat();
  }
}





//Variables for speech functions, courtesy of Peter Knight's Talkie library
const uint8_t spPAUSE1[] PROGMEM = { 0x08, 0x14, 0xC1, 0xDD, 0x45, 0x64, 0x03, 0x00, 0xFC, 0x4A, 0x56, 0x26, 0x3A, 0x06, 0x0A };

const uint8_t spPLUS[] PROGMEM = { 0x02, 0xF0, 0xD6, 0xCC, 0x01, 0x51, 0x8B, 0x8D, 0xA2, 0x29, 0x65, 0x4B, 0x5F,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 0x79, 0x05 };

const uint8_t spFIVE[] PROGMEM = { 0x08, 0xE8, 0xD2, 0x15, 0x03, 0x02, 0xA8, 0x3A, 0x5D, 0x01, 0x55, 0x96, 0x0E,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 0x5A, 0x56 };

const uint8_t spMINUS[] PROGMEM = { 0xAE, 0x48, 0xCA, 0xB4, 0x51, 0xB6, 0xE4, 0xA2, 0x65, 0xD9, 0x84, 0x25, 0xE2,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 0x79, 0x59 };

const uint8_t spONE[] PROGMEM = { 0xA6, 0x90, 0x76, 0xCC, 0x43, 0x6B, 0xB9, 0x42, 0xD8, 0x35, 0x77, 0xA9, 0x19,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 0xF8, 0x26 };

const uint8_t spPOINT[] PROGMEM = { 0x02, 0xC8, 0x5A, 0x5C, 0x00, 0x45, 0x4E, 0x25, 0xB7, 0xF0, 0x2C, 0x4D, 0x74,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 0x79, 0x05 };

const uint8_t sp_S[] PROGMEM = { 0x04, 0xF8, 0xD4, 0x5D, 0x00, 0x8F, 0xB9, 0x0B, 0xE0, 0x4B, 0x33, 0x06, 0x7C,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 0x15, 0x5A };

const uint8_t spPRESS[] PROGMEM = { 0x04, 0xA8, 0x34, 0x9D, 0x01, 0x2D, 0x44, 0x0A, 0x20, 0xF7, 0xAC, 0x60, 0xA7,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 0x25, 0x05 };

const uint8_t spBUTTON[] PROGMEM = { 0xA9, 0x69, 0xCE, 0xC2, 0x45, 0x14, 0x9F, 0x28, 0xFB, 0xB5, 0x14, 0xDD, 0x78,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 0xFF, 0x61 };

const uint8_t spB[] PROGMEM = { 0xA9, 0xB2, 0x56, 0x3D, 0xBD, 0x2B, 0x95, 0xB8, 0x28, 0xC1, 0x9D, 0xAD, 0xD5,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 0x41, 0x21 };

const uint8_t spTWO[] PROGMEM = { 0x0E, 0x58, 0x56, 0xCB, 0x00, 0xD7, 0xAB, 0x19, 0xE0, 0x38, 0xCB, 0xE6, 0x0C,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 0x5A, 0x26 };

const uint8_t spTRY[] PROGMEM = { 0x06, 0x98, 0xA9, 0x2D, 0x01, 0x33, 0xB5, 0x3B, 0xA0, 0x87, 0x8C, 0xE6, 0xD7,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 0x75, 0x15 };

const uint8_t spAGAIN[] PROGMEM = { 0xA9, 0x28, 0x2E, 0x64, 0x68, 0x26, 0xAF, 0xB2, 0x26, 0xF3, 0xA4, 0xAE, 0x73,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 0x59, 0x41 };